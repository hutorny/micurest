_M_( 0)="[0.00292969,0.0146484,0.0454102]";
_M_( 2)="{\"proto\":\"\",\"ipaddr\":[192,168,159,47],\"netmask\":[0,0,0,0],\"gwaddr\":[0,0,0,0],\"expires\":0,\"uptime\":0,\"ifname\":\"\",\"dns\":[[0,0,0,0],[0,0,0,0],[0,0,0,0],[0,0,0,0]]}";
_M_( 3)="{\"wan\":{\"proto\":\"dhcp\",\"ipaddr\":[127,0,0,1],\"netmask\":[255,0,0,0],\"gwaddr\":[10,0,0,1],\"expires\":30000,\"uptime\":100,\"ifname\":\"eth0\",\"dns\":[[8,8,8,8],[1,2,3,4],[5,6,7,8],[0,0,0,0]]},\"localtime\":\"Tue Sep  8 06:21:31 2015\",\"uptime\":8,\"conncount\":2,\"connmax\":4,\"memcached\":3,\"membuffers\":1,\"swapcached\":5,\"swaptotal\":6,\"memfree\":7,\"wifinets\":[{\"device\":\"\",\"networks\":[{\"ifname\":\"\",\"encryption\":\"\",\"ssid\":\"\",\"mode\":\"\",\"bssid\":\"\",\"quality\":0,\"noise\":0},{\"ifname\":\"\",\"encryption\":\"\",\"ssid\":\"\",\"mode\":\"\",\"bssid\":\"\",\"quality\":0,\"noise\":0},{\"ifname\":\"\",\"encryption\":\"\",\"ssid\":\"\",\"mode\":\"\",\"bssid\":\"\",\"quality\":0,\"noise\":0},{\"ifname\":\"\",\"encryption\":\"\",\"ssid\":\"\",\"mode\":\"\",\"bssid\":\"\",\"quality\":0,\"noise\":0}],\"name\":\"\",\"up\":false},{\"device\":\"\",\"networks\":[{\"ifname\":\"\",\"encryption\":\"\",\"ssid\":\"\",\"mode\":\"\",\"bssid\":\"\",\"quality\":0,\"noise\":0},{\"ifname\":\"\",\"encryption\":\"\",\"ssid\":\"\",\"mode\":\"\",\"bssid\":\"\",\"quality\":0,\"noise\":0},{\"ifname\":\"\",\"encryption\":\"\",\"ssid\":\"\",\"mode\":\"\",\"bssid\":\"\",\"quality\":0,\"noise\":0},{\"ifname\":\"\",\"encryption\":\"\",\"ssid\":\"\",\"mode\":\"\",\"bssid\":\"\",\"quality\":0,\"noise\":0}],\"name\":\"\",\"up\":false},{\"device\":\"\",\"networks\":[{\"ifname\":\"\",\"encryption\":\"\",\"ssid\":\"\",\"mode\":\"\",\"bssid\":\"\",\"quality\":0,\"noise\":0},{\"ifname\":\"\",\"encryption\":\"\",\"ssid\":\"\",\"mode\":\"\",\"bssid\":\"\",\"quality\":0,\"noise\":0},{\"ifname\":\"\",\"encryption\":\"\",\"ssid\":\"\",\"mode\":\"\",\"bssid\":\"\",\"quality\":0,\"noise\":0},{\"ifname\":\"\",\"encryption\":\"\",\"ssid\":\"\",\"mode\":\"\",\"bssid\":\"\",\"quality\":0,\"noise\":0}],\"name\":\"\",\"up\":false},{\"device\":\"\",\"networks\":[{\"ifname\":\"\",\"encryption\":\"\",\"ssid\":\"\",\"mode\":\"\",\"bssid\":\"\",\"quality\":0,\"noise\":0},{\"ifname\":\"\",\"encryption\":\"\",\"ssid\":\"\",\"mode\":\"\",\"bssid\":\"\",\"quality\":0,\"noise\":0},{\"ifname\":\"\",\"encryption\":\"\",\"ssid\":\"\",\"mode\":\"\",\"bssid\":\"\",\"quality\":0,\"noise\":0},{\"ifname\":\"\",\"encryption\":\"\",\"ssid\":\"\",\"mode\":\"\",\"bssid\":\"\",\"quality\":0,\"noise\":0}],\"name\":\"\",\"up\":false}],\"memtotal\":9,\"localtime\":\"Tue Sep  8 06:21:31 2015\",\"swapfree\":10,\"loadavg\":[0.001,0.01,0.1]}";
_M_( 4)="{\"wan\":{\"proto\":\"dhcp\",\"ipaddr\":[192,168,159,47],\"netmask\":[255,255,255,0],\"gwaddr\":[192,168,159,1],\"expires\":-1,\"uptime\":10176769,\"ifname\":\"br-wan\",\"dns\":[[192,168,158,6],[192,168,158,2],[192,168,158,1],[0,0,0,0]]},\"localtime\":\"Tue Sep  8 06:21:31 2015\",\"uptime\":10176796,\"conncount\":87,\"connmax\":16384,\"memcached\":7576,\"membuffers\":2076,\"swapcached\":0,\"swaptotal\":0,\"memfree\":-30208,\"wifinets\":[{\"device\":\"radio0\",\"networks\":[{\"ifname\":\"wlan0\",\"encryption\":\"WPA2 PSK (CCMP)\",\"ssid\":\"json\",\"mode\":\"Master\",\"bssid\":\"C4:93:00:00:1D:AF\",\"quality\":51,\"noise\":-95},{\"ifname\":\"\",\"encryption\":\"\",\"ssid\":\"\",\"mode\":\"\",\"bssid\":\"\",\"quality\":0,\"noise\":0},{\"ifname\":\"\",\"encryption\":\"\",\"ssid\":\"\",\"mode\":\"\",\"bssid\":\"\",\"quality\":0,\"noise\":0},{\"ifname\":\"\",\"encryption\":\"\",\"ssid\":\"\",\"mode\":\"\",\"bssid\":\"\",\"quality\":0,\"noise\":0}],\"name\":\"Generic 802.11bgn Wireless Controller (radio0)\",\"up\":true},{\"device\":\"\",\"networks\":[{\"ifname\":\"\",\"encryption\":\"\",\"ssid\":\"\",\"mode\":\"\",\"bssid\":\"\",\"quality\":0,\"noise\":0},{\"ifname\":\"\",\"encryption\":\"\",\"ssid\":\"\",\"mode\":\"\",\"bssid\":\"\",\"quality\":0,\"noise\":0},{\"ifname\":\"\",\"encryption\":\"\",\"ssid\":\"\",\"mode\":\"\",\"bssid\":\"\",\"quality\":0,\"noise\":0},{\"ifname\":\"\",\"encryption\":\"\",\"ssid\":\"\",\"mode\":\"\",\"bssid\":\"\",\"quality\":0,\"noise\":0}],\"name\":\"\",\"up\":false},{\"device\":\"\",\"networks\":[{\"ifname\":\"\",\"encryption\":\"\",\"ssid\":\"\",\"mode\":\"\",\"bssid\":\"\",\"quality\":0,\"noise\":0},{\"ifname\":\"\",\"encryption\":\"\",\"ssid\":\"\",\"mode\":\"\",\"bssid\":\"\",\"quality\":0,\"noise\":0},{\"ifname\":\"\",\"encryption\":\"\",\"ssid\":\"\",\"mode\":\"\",\"bssid\":\"\",\"quality\":0,\"noise\":0},{\"ifname\":\"\",\"encryption\":\"\",\"ssid\":\"\",\"mode\":\"\",\"bssid\":\"\",\"quality\":0,\"noise\":0}],\"name\":\"\",\"up\":false},{\"device\":\"\",\"networks\":[{\"ifname\":\"\",\"encryption\":\"\",\"ssid\":\"\",\"mode\":\"\",\"bssid\":\"\",\"quality\":0,\"noise\":0},{\"ifname\":\"\",\"encryption\":\"\",\"ssid\":\"\",\"mode\":\"\",\"bssid\":\"\",\"quality\":0,\"noise\":0},{\"ifname\":\"\",\"encryption\":\"\",\"ssid\":\"\",\"mode\":\"\",\"bssid\":\"\",\"quality\":0,\"noise\":0},{\"ifname\":\"\",\"encryption\":\"\",\"ssid\":\"\",\"mode\":\"\",\"bssid\":\"\",\"quality\":0,\"noise\":0}],\"name\":\"\",\"up\":false}],\"memtotal\":61780,\"localtime\":\"Tue Sep  8 06:21:31 2015\",\"swapfree\":0,\"loadavg\":[0.00292969,0.0146484,0.0454102]}";
