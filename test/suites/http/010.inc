_M_( 0)="HTTP/1.1 404 Not Found\r\nConnection: close\r\n\r\nNot Found\r\n";
_M_( 1)="HTTP/1.1 200 OK\r\nContent-Type: text/html\r\nContent-Length: 59\r\nConnection: close\r\n\r\n<html>\n\t<body>\n\t<h1>Plain text values</h1>\n\t</body>\n</html>";
_M_( 2)="HTTP/1.1 200 OK\r\nContent-Type: text/html\r\nContent-Length: 59\r\nConnection: close\r\n\r\n<html>\n\t<body>\n\t<h1>Plain text values</h1>\n\t</body>\n</html>";
_M_( 3)="HTTP/0.1 200 OK\r\nContent-Type: text/html\r\nContent-Length: 59\r\nConnection: close\r\n\r\n<html>\n\t<body>\n\t<h1>Plain text values</h1>\n\t</body>\n</html>";
_M_( 4)="HTTP/1.1 200 OK\r\nContent-Type: application/json\r\nConnection: close\r\n\r\n0";
_M_( 5)="HTTP/1.1 200 OK\r\nContent-Type: application/json\r\nConnection: close\r\n\r\n0";
_M_( 6)="HTTP/1.1 200 OK\r\nContent-Type: application/json\r\nConnection: close\r\n\r\n0";
_M_( 7)="HTTP/1.1 200 OK\r\nContent-Type: application/json\r\nConnection: close\r\n\r\n0";
_M_( 8)="HTTP/1.1 204 No Content\r\nConnection: close\r\n";
_M_( 9)="HTTP/1.1 200 OK\r\nContent-Type: application/json\r\nConnection: close\r\n\r\nfalse";
_M_(10)="HTTP/1.1 204 No Content\r\nConnection: close\r\n";
_M_(11)="HTTP/0.1 200 OK\r\nContent-Type: application/json\r\nConnection: close\r\n\r\nfalse";
_M_(12)="HTTP/1.1 200 OK\r\nContent-Type: text/plain\r\nContent-Length: 0\r\nConnection: close\r\n\r\n";
_M_(13)="HTTP/1.1 200 OK\r\nContent-Type: application/json\r\nConnection: close\r\n\r\n0";
_M_(14)="HTTP/1.1 204 No Content\r\nConnection: close\r\n";
_M_(15)="HTTP/1.1 200 OK\r\nContent-Type: application/json\r\nConnection: close\r\n\r\n0";
_M_(16)="HTTP/1.1 204 No Content\r\nConnection: close\r\nHTTP/1.1 200 OK\r\nContent-Type: application/json\r\nConnection: close\r\n\r\n65535";
_M_(17)="HTTP/1.1 204 No Content\r\nConnection: close\r\nHTTP/1.1 200 OK\r\nContent-Type: text/plain\r\nContent-Length: 18\r\nConnection: close\r\n\r\na single line text";
_M_(18)="HTTP/1.1 204 No Content\r\nConnection: close\r\nHTTP/1.1 200 OK\r\nContent-Type: text/plain\r\nContent-Length: 23\r\nConnection: close\r\n\r\nmultiple\nlines\n\320\274essage";
_M_(19)="HTTP/1.1 204 No Content\r\nConnection: close\r\nHTTP/1.1 200 OK\r\nContent-Type: application/octet-stream\r\nContent-Length: 27\r\nConnection: close\r\n\r\n";
