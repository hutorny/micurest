_M_( 0)="HTTP/1.1 501 Not Implemented\r\nContent-Type: text/plain\r\nConnection: close\r\n\r\nNot Implemented\r\n";
_M_( 1)="HTTP/1.1 415 Unsupported Content Format\r\nConnection: close\r\n\r\nUnsupported Content Format\r\n";
_M_( 2)="HTTP/1.1 404 Not Found\r\nContent-Type: text/plain\r\nConnection: close\r\n\r\nNot Found\r\n";
_M_( 3)="HTTP/1.1 415 Unsupported Content Format\r\nConnection: close\r\n\r\nUnsupported Content Format\r\n";
_M_( 4)="HTTP/1.1 200 OK\r\nConnection: close\r\n\r\n{\"data\":3}";
_M_( 5)="HTTP/1.1 415 Unsupported Content Format\r\nConnection: close\r\n\r\nUnsupported Content Format\r\n";
_M_( 6)="HTTP/1.1 501 Not Implemented\r\nContent-Type: text/plain\r\nConnection: close\r\n\r\nNot Implemented\r\n";
