_M_( 0)="{\"c\":126,\"i\":-25536,\"l\":9999999,\"u\":2147483648}";
_M_( 1)="{\"c\":-127,\"i\":30856,\"l\":2040109465,\"u\":-8690465821745195400,\"s\":\"solidus \\\\\\\\\\\\\\\\\\\\\\\\\\\\\"}";
_M_( 2)="{\"c\":126,\"i\":-25536,\"l\":9999999,\"u\":2147483648}";
_M_( 3)="{\"c\":1,\"i\":2,\"l\":3,\"u\":4,\"s\":\"d\\u000namic\"}";
_M_( 4)="47653";
_M_( 5)="\"char*\"";
_M_( 6)="\"const char*\"";
_M_( 7)="\"char[]\"";
_M_( 8)="{\"c\":1,\"i\":2,\"l\":3,\"u\":4}";
_M_( 9)="{\"c\":10,\"i\":20,\"l\":30,\"u\":40}";
_M_(10)="{\"c\":100,\"i\":200,\"l\":300,\"u\":400,\"s\":\"100200300400500\"}";
_M_(11)="{\"c\":-12,\"i\":210,\"l\":310,\"u\":8675414341395437176,\"s\":\"000210310000500\"}";
_M_(12)="21031";
